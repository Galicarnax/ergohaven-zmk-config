## config/west.yml
```yaml
manifest:
  remotes:
    - name: ergohaven
      url-base: https://github.com/ergohaven

    - name: badjeff
      url-base: https://github.com/badjeff
    - name: carrefinho
      url-base: https://github.com/carrefinho
    - name: janpfischer
      url-base: https://github.com/janpfischer
    - name: zzeneg
      url-base: https://github.com/zzeneg
  projects:
    - name: ergohaven-zmk
      remote: ergohaven
      revision: main
    - name: zmk-pmw3610-driver
      remote: badjeff
      revision: main
    - name: prospector-zmk-module
      remote: carrefinho
      revision: main
    - name: zmk-dongle-screen
      remote: janpfischer
      revision: main
    - name: zmk-raw-hid
      remote: zzeneg
      revision: main
  self:
    path: config
```
